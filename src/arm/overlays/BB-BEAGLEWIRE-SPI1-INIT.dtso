// SPDX-License-Identifier: GPL-2.0-only
/dts-v1/;
/plugin/;

/ {
    fragment@0 {
        target = <&am33xx_pinmux>;
        __overlay__ {
            spi1_pins: spi1_pins {
                pinctrl-single,pins = <
                    0x190 0x33  /* P9_31 spi1_sclk, MODE3 | INPUT | PULLUP */
                    0x194 0x33  /* P9_29 spi1_d0,   MODE3 | INPUT | PULLUP */
                    0x198 0x13  /* P9_30 spi1_d1,   MODE3 | OUTPUT */
                    0x19c 0x13  /* P9_28 spi1_cs0,  MODE3 | OUTPUT */
                >;
            };
        };
    };

    fragment@1 {
        target = <&spi1>;
        __overlay__ {
            status = "okay";
            pinctrl-names = "default";
            pinctrl-0 = <&spi1_pins>;

            #address-cells = <1>;
            #size-cells = <0>;

            spidev@0 {
                compatible = "rohm,dh2228fv";
                reg = <0>;
                spi-max-frequency = <1000000>;
            };
        };
    };
};
